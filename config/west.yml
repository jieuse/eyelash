## config/west.yml
```yaml
manifest:
  remotes:
    - name: zmkfirmware
      url-base: https://github.com/zmkfirmware

    - name: gpeye
      url-base: https://github.com/GPeye

    - name: Arawasu
      url-base: https://github.com/Arawasu

  projects:
    - name: zmk-sofle-eyelash-config
      url: https://github.com/Arawasu/zmk-sofle-eyelash-config
      revision: main

    - name: hammerbeam-slideshow
      remote: Arawasu
      revision: main

    - name: zmk
      remote: zmkfirmware
      # main = Zephyr 4.1 / HWMv2; 本仓库板级仍是旧格式，CI 会 CMake/Kconfig 失败。先跟 v0.3，再按需升级并迁移板子。
      revision: v0.3
      import: app/west.yml

    - name: zmk-nice-oled
      remote: Arawasu
      revision: main

  self:
    path: config
```
